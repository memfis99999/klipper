## src/configs/Creality/K1_noz0_110_S06_defconfig
```kconfig
CONFIG_LOW_LEVEL_OPTIONS=y
CONFIG_MACH_STM32=y
CONFIG_BOARD_DIRECTORY="stm32"
CONFIG_MCU="stm32g071xx"
CONFIG_CLOCK_FREQ=64000000
CONFIG_SERIAL=y
CONFIG_FLASH_SIZE=0x20000
CONFIG_FLASH_BOOT_ADDRESS=0x8000000
CONFIG_RAM_START=0x20000000
CONFIG_RAM_SIZE=0x9000
CONFIG_STACK_SIZE=512
CONFIG_FLASH_APPLICATION_ADDRESS=0x8003000
CONFIG_STM32_SELECT=y
CONFIG_MACH_STM32G071=y
CONFIG_MACH_STM32G0=y
CONFIG_MACH_STM32G07x=y
CONFIG_STM32_USB_DOUBLE_BUFFER_TX=y
CONFIG_STM32_DFU_ROM_ADDRESS=0
CONFIG_STM32_FLASH_START_3000=y
CONFIG_STM32_CLOCK_REF_8M=y
CONFIG_CLOCK_REF_FREQ=8000000
CONFIG_STM32F0_TRIM=16
CONFIG_STM32_SERIAL_USART2=y
CONFIG_SERIAL_BAUD=230400
CONFIG_USB_VENDOR_ID=0x1d50
CONFIG_USB_DEVICE_ID=0x614e
CONFIG_USB_SERIAL_NUMBER="12345"
CONFIG_WANT_ADC=y
CONFIG_WANT_SPI=y
CONFIG_WANT_SOFTWARE_SPI=y
CONFIG_WANT_I2C=y
CONFIG_WANT_SOFTWARE_I2C=y
CONFIG_WANT_HARD_PWM=y
CONFIG_WANT_BUTTONS=y
CONFIG_WANT_TMCUART=y
CONFIG_WANT_NEOPIXEL=y
CONFIG_WANT_PULSE_COUNTER=y
CONFIG_WANT_ST7920=y
CONFIG_WANT_HD44780=y
CONFIG_WANT_ADXL345=y
CONFIG_WANT_LIS2DW=y
CONFIG_WANT_MPU9250=y
CONFIG_WANT_ICM20948=y
CONFIG_WANT_THERMOCOUPLE=y
CONFIG_WANT_HX71X=y
CONFIG_WANT_ADS1220=y
CONFIG_WANT_LDC1612=y
CONFIG_WANT_SENSOR_ANGLE=y
CONFIG_NEED_SENSOR_BULK=y
CONFIG_WANT_TRIGGER_ANALOG=y
CONFIG_NEED_SOS_FILTER=y
CONFIG_CANBUS_FREQUENCY=1000000
CONFIG_INLINE_STEPPER_HACK=y
CONFIG_HAVE_STEPPER_OPTIMIZED_BOTH_EDGE=y
CONFIG_WANT_STEPPER_OPTIMIZED_BOTH_EDGE=y
CONFIG_INITIAL_PINS="!PB14,!PB15,!PA8"
CONFIG_HAVE_GPIO=y
CONFIG_HAVE_GPIO_ADC=y
CONFIG_HAVE_GPIO_SPI=y
CONFIG_HAVE_GPIO_I2C=y
CONFIG_HAVE_GPIO_HARD_PWM=y
CONFIG_HAVE_STRICT_TIMING=y
CONFIG_HAVE_CHIPID=y
CONFIG_HAVE_BOOTLOADER_REQUEST=y
CONFIG_MACH_CREALITY_OTHERS=y
CONFIG_BUILD_MACHINE_UID=""
CONFIG_BOARD_INFO_CONFIGURE=y
CONFIG_NOZZLE_MCU_BOARD=y
CONFIG_MCU_BOARD_ID=0
CONFIG_MCU_BOARD_HW_VER=110
CONFIG_MCU_BOARD_FW_VER=005
CONFIG_MCU_BOARD_FW_RESERVED=000
CONFIG_CREALITY_MCU_MENU="S"
CONFIG_CREALITY_MCU_TYPE="06"
```

## src/configs/Creality/Kconfig
```kconfig
# Creality integration options

menu "Creality options"
    depends on MACH_STM32 || MACH_GD32

choice
    prompt "Creality machine type"
    default MACH_CREALITY_OTHERS
config MACH_CREALITY_OTHERS
    bool "CREALITY others"
config MACH_CREALITY_CR_10_SMART
    bool "CREALITY CR-10 SMART"
endchoice

config BUILD_MACHINE_UID
    string "Custom your machine firmware name as unique ID"
    depends on LOW_LEVEL_OPTIONS
    help
        Used by host to distinguish printers.

# --- Board info / Creality board update ---
config BOARD_INFO_CONFIGURE
    bool "Board info configure"
    default n
    help
        Enable board info configure, we can update mcu firmware
        by Linux with uart port.

menu "Board Configure"
    depends on BOARD_INFO_CONFIGURE

choice
    prompt "Board Type"
    default MAIN_MCU_BOARD
config MAIN_MCU_BOARD
    bool "Main MCU"
config NOZZLE_MCU_BOARD
    bool "Nozzle MCU"
config BED_MCU_BOARD
    bool "Bed MCU"
config EXT_MCU_BOARD
    bool "Extended MCU"
endchoice

config MCU_BOARD_ID
    int "MCU Board ID"
    default 0

config MCU_BOARD_HW_VER
    int "HW Version"
    default 0

config MCU_BOARD_FW_VER
    int "FW Version"
    default 0

config MCU_BOARD_FW_RESERVED
    int "FW Reserved"
    default 0

endmenu # Board Configure

config CREALITY_MCU_MENU
    string
    default "S" if MACH_STM32
    default "G" if MACH_GD32

config CREALITY_MCU_TYPE
    string
    default "00" if MACH_STM32F030
    default "01" if MACH_STM32F031
    default "02" if MACH_STM32F042
    default "03" if MACH_STM32F070
    default "04" if MACH_STM32F072
    default "05" if MACH_STM32F0x2
    default "10" if MACH_STM32F103
    default "20" if MACH_STM32F207
    default "40" if MACH_STM32F401
    default "41" if MACH_STM32F405
    default "42" if MACH_STM32F429
    default "43" if MACH_STM32F446
    default "44" if MACH_STM32F4x5
    default "70" if MACH_STM32H723
    default "71" if MACH_STM32H743
    default "72" if MACH_STM32H750
    default "06" if MACH_STM32G071
    default "07" if MACH_STM32G0B1

    default "30" if MACH_GD32F303XB
    default "31" if MACH_GD32F303XC
    default "32" if MACH_GD32F303XE
    default "33" if MACH_GD32F303XG
    default "34" if MACH_GD32F303XI
    default "35" if MACH_GD32F303XK
    default "36" if MACH_GD32F305XB
    default "37" if MACH_GD32F305XC
    default "38" if MACH_GD32F305XE
    default "39" if MACH_GD32F305XG
    default "3a" if MACH_GD32F307XC
    default "3b" if MACH_GD32F307XE
    default "3c" if MACH_GD32F307XG
    default "20" if MACH_GD32E230X6
    default "21" if MACH_GD32E230X8

endmenu # Creality options
```
